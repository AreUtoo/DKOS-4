/*
 * Copyright (c) 2025 VEXC HOW DESIGN
 * Copyright (c) 2020 Pete Johanson
 *
 * SPDX-License-Identifier: MIT
 */

#include "vhd.dtsi"

&default_transform {
	col-offset = <7>;
};

&kscan0 {
	col-gpios
		= <&gpio0 10 (GPIO_ACTIVE_HIGH | GPIO_PULL_DOWN)>
		, <&gpio1 11 (GPIO_ACTIVE_HIGH | GPIO_PULL_DOWN)>
		, <&gpio1 13 (GPIO_ACTIVE_HIGH | GPIO_PULL_DOWN)>
		, <&gpio1 15 (GPIO_ACTIVE_HIGH | GPIO_PULL_DOWN)>
		, <&gpio0 2 (GPIO_ACTIVE_HIGH | GPIO_PULL_DOWN)>
		, <&gpio0 29  (GPIO_ACTIVE_HIGH | GPIO_PULL_DOWN)>
		, <&gpio0 31 (GPIO_ACTIVE_HIGH | GPIO_PULL_DOWN)>
		;
};
