## config/boards/shields/vhd/Kconfig.defconfig
```kconfig
if SHIELD_vhd_LEFT

config ZMK_KEYBOARD_NAME
    default "vhd"

config ZMK_SPLIT_ROLE_CENTRAL
    default y

endif

if SHIELD_vhd_LEFT || SHIELD_vhd_RIGHT

config ZMK_SPLIT
    default y

endif
```

## config/boards/shields/vhd/Kconfig.shield
```kconfig
# Copyright (c) 2025 VEXC HOW DESIGN
# Copyright (c) 2020 Pete Johanson
# SPDX-License-Identifier: MIT

config SHIELD_vhd_LEFT
    def_bool $(shields_list_contains,vhd_left)

config SHIELD_vhd_RIGHT
    def_bool $(shields_list_contains,vhd_right)
```
